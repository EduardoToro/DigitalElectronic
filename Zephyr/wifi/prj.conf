## CMakeLists.txt
```
# SPDX-License-Identifier: Apache-2.0

cmake_minimum_required(VERSION 3.20.0)

find_package(Zephyr REQUIRED HINTS $ENV{ZEPHYR_BASE})
project(wifi)

# FILE(GLOB app_sources src/*.c)
target_sources(app PRIVATE ${app_sources})
target_sources(app PRIVATE src/main.c)
target_sources_ifdef(CONFIG_WIFI app PRIVATE src/wifi.c)
```

## Kconfig
```
if WIFI

config WIFI_SSID
	string "WIFI SSID - Network name"
	default "my_network"

config WIFI_PSK
	string "WIFI PSK - Network password key"
	default "secret_passwd"

endif # WIFI

source "Kconfig.zephyr"
```

## sample.yaml
```
common:
  harness: net
  tags: net wifi
sample:
  description: Test wifi driver and APIs functionality
  name: WiFi sample app
tests:
  sample.net.wifi:
    platform_allow: cc3220sf_launchxl disco_l475_iot1 reel_board
  sample.net.wifi.mikroe_wifi_bt_click:
    extra_args: SHIELD=mikroe_wifi_bt_click_mikrobus
    platform_allow: lpcxpresso55s69_cpu0
  sample.net.wifi.esp_8266:
    extra_args: SHIELD=esp_8266
    platform_allow: sam4e_xpro
  sample.net.wifi.esp_8266_arduino:
    extra_args: SHIELD=esp_8266_arduino
    platform_allow: frdm_k64f disco_l475_iot1
  sample.net.wifi.inventek_eswifi_arduino_uart:
    extra_args: SHIELD=inventek_eswifi_arduino_uart
    platform_allow: frdm_k64f nucleo_f767zi
  sample.net.wifi.inventek_eswifi_arduino_spi:
    extra_args: SHIELD=inventek_eswifi_arduino_spi
    platform_allow: frdm_k64f nucleo_f767zi
  esp32:
    extra_args: OVERLAY_CONFIG="overlay-wifi.conf"
    platform_allow: esp32
```

## prj.conf
```kconfig
CONFIG_EARLY_CONSOLE=y
# CONFIG_EARLY_CONSOLE=n

CONFIG_NETWORKING=y
# CONFIG_TEST_RANDOM_GENERATOR=y
CONFIG_TEST_RANDOM_GENERATOR=n

CONFIG_NET_TX_STACK_SIZE=2048
CONFIG_NET_RX_STACK_SIZE=2048

CONFIG_NET_PKT_RX_COUNT=10
CONFIG_NET_PKT_TX_COUNT=10
CONFIG_NET_BUF_RX_COUNT=20
CONFIG_NET_BUF_TX_COUNT=20
CONFIG_NET_MAX_CONTEXTS=10
CONFIG_NET_DHCPV4=y

CONFIG_NET_IPV4=y
CONFIG_NET_IPV6=n

CONFIG_NET_TCP=y

CONFIG_LOG=y
# CONFIG_NET_LOG=y # usar
CONFIG_INIT_STACKS=y

# CONFIG_NET_SHELL=n
CONFIG_NET_SHELL=y

CONFIG_NET_STATISTICS=y
CONFIG_NET_STATISTICS_PERIODIC_OUTPUT=n

##############
# WIFI CONFIG
##############

CONFIG_WIFI=y
CONFIG_WIFI_LOG_LEVEL_ERR=y
CONFIG_NET_L2_WIFI_SHELL=y

CONFIG_HEAP_MEM_POOL_SIZE=98304
CONFIG_NET_L2_ETHERNET=y

CONFIG_WIFI_SSID="vivo Y33s"
CONFIG_WIFI_PSK="xxxxxxxx"
CONFIG_ESP32_WIFI_STA_AUTO_DHCPV4=y
```

## src/main.c
```c
#include <zephyr/logging/log.h>
#include <zephyr/kernel.h>
#include <stdio.h>

#include "wifi.h"

LOG_MODULE_REGISTER(main, CONFIG_LOG_DEFAULT_LEVEL);

void main(void)
{
	LOG_INF("WiFi demo");

	wifi_connect();

}
```

## src/wifi.c
```c
/*
 * Copyright (c) 2020 Gerson Fernando Budke <nandojve@gmail.com>
 *
 * SPDX-License-Identifier: Apache-2.0
 */

#include <zephyr/logging/log.h>
LOG_MODULE_DECLARE(main, CONFIG_LOG_DEFAULT_LEVEL);

#include <zephyr/net/wifi_mgmt.h>

static int connected;
static struct net_mgmt_event_callback wifi_shell_mgmt_cb;

static void handle_wifi_connect_result(struct net_mgmt_event_callback *cb)
{
	const struct wifi_status *status = (const struct wifi_status *)
					   cb->info;

	if (status->status) {
		LOG_ERR("Connection request failed (%d)", status->status);
	} else {
		LOG_INF("WIFI Connected");
		connected = 1;
	}
}

static void wifi_mgmt_event_handler(struct net_mgmt_event_callback *cb,
				    uint32_t mgmt_event, struct net_if *iface)
{
	switch (mgmt_event) {
	case NET_EVENT_WIFI_CONNECT_RESULT:
		handle_wifi_connect_result(cb);
		break;
	default:
		break;
	}
}

void wifi_connect(void)
{
	int nr_tries = 10;
	int ret = 0;

	net_mgmt_init_event_callback(&wifi_shell_mgmt_cb,
				     wifi_mgmt_event_handler,
				     NET_EVENT_WIFI_CONNECT_RESULT);

	net_mgmt_add_event_callback(&wifi_shell_mgmt_cb);

	struct net_if *iface = net_if_get_default();
	static struct wifi_connect_req_params cnx_params = {
		.ssid = CONFIG_WIFI_SSID,
		.ssid_length = 0,
		.psk = CONFIG_WIFI_PSK,
		.psk_length = 0,
		.channel = 0,
		.security = WIFI_SECURITY_TYPE_PSK,
	};

	cnx_params.ssid_length = strlen(CONFIG_WIFI_SSID);
	cnx_params.psk_length = strlen(CONFIG_WIFI_PSK);

	connected = 0;

	LOG_INF("WIFI try connecting to %s...", CONFIG_WIFI_SSID);

	/* Let's wait few seconds to allow wifi device be on-line */
	while (nr_tries-- > 0) {
		ret = net_mgmt(NET_REQUEST_WIFI_CONNECT, iface, &cnx_params,
			       sizeof(struct wifi_connect_req_params));
		if (ret == 0) {
			break;
		}

		LOG_INF("Connect request failed %d. Waiting iface be up...", ret);
		k_msleep(500);
	}

	while (connected == 0) {
		k_msleep(100);
	}
}
```
