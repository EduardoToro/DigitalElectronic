#include <zephyr/dt-bindings/adc/adc.h>

/{
	aliases {
		uart2 = &uart2; 
		uart0 = &uart0; 
  	};
}; 

&uart0 {
		current-speed = <115200>;
		status = "okay";
		pinctrl-0 = <&uart0_default>;
		pinctrl-names = "default";
	};

&uart2 {
		current-speed = <9600>;
		status = "okay";
		pinctrl-0 = <&uart2_default>;
		pinctrl-names = "default";
	};