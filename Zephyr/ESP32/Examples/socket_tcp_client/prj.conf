## prj.conf
```kconfig
CONFIG_EARLY_CONSOLE=y
# CONFIG_EARLY_CONSOLE=n

CONFIG_NETWORKING=y
# CONFIG_TEST_RANDOM_GENERATOR=y
CONFIG_TEST_RANDOM_GENERATOR=n

CONFIG_NET_TX_STACK_SIZE=2048
CONFIG_NET_RX_STACK_SIZE=2048

CONFIG_NET_PKT_RX_COUNT=10
CONFIG_NET_PKT_TX_COUNT=10
CONFIG_NET_BUF_RX_COUNT=20
CONFIG_NET_BUF_TX_COUNT=20
CONFIG_NET_MAX_CONTEXTS=10
CONFIG_NET_DHCPV4=y

CONFIG_NET_IPV4=y
CONFIG_NET_IPV6=n

CONFIG_NET_TCP=y

#############
# LOG CONFIG
#############
CONFIG_LOG=y
CONFIG_NET_LOG=y # usar
CONFIG_INIT_STACKS=y

# CONFIG_NET_SHELL=n
CONFIG_NET_SHELL=y

CONFIG_NET_STATISTICS=y
CONFIG_NET_STATISTICS_PERIODIC_OUTPUT=n

################
# SOCKET CONFIG
################

CONFIG_NET_SOCKETS=y

##############
# WIFI CONFIG
##############

CONFIG_WIFI=y
CONFIG_WIFI_LOG_LEVEL_ERR=n
CONFIG_NET_L2_WIFI_SHELL=y

CONFIG_HEAP_MEM_POOL_SIZE=98304
CONFIG_NET_L2_ETHERNET=y

##############
# WIFI and TCP CONFIG
##############
CONFIG_WIFI_SSID="ssid"
CONFIG_WIFI_PSK="pass"
CONFIG_IP_SERVER="192.168.1.6"
CONFIG_PORT_SERVER=3000 
# CONFIG_ESP32_WIFI_STA_AUTO_DHCPV4=y
```

## overlay-wifi.conf
```kconfig
CONFIG_WIFI_SSID="Nombre de red"
CONFIG_WIFI_PSK="Password"
/* CONFIG_ESP32_WIFI_STA_AUTO_DHCPV4=y */
```

## src/dhcp.h
```c
/* DHCPv4 client startup. */

/*
 * Copyright (c) 2018 Linaro Ltd
 *
 * SPDX-License-Identifier: Apache-2.0
 */

#ifndef __DHCP_H__
#define __DHCP_H__

void dhcpv4_startup(void);

#endif /* not __DHCP_H__ */
```

## src/tcp_client.c
```c
// Client side C/C++ program to demonstrate Socket
// programming

#include "tcp_client.h"
/* LOG_MODULE_DECLARE(main, CONFIG_LOG_DEFAULT_LEVEL); */

static ssize_t sendall(int sock, const void *buf, size_t len)
{
	while (len) {
		ssize_t out_len = send(sock, buf, len, 0);

		if (out_len < 0) {
			return out_len;
		}
		buf = (const char *)buf + out_len;
		len -= out_len;
	}

	return 0;
}
 
int tcp_client_start(void)
{
  LOG_MODULE_DECLARE(main, CONFIG_LOG_DEFAULT_LEVEL);
  /* LOG_MODULE_DECLARE(main, CONFIG_LOG_DEFAULT_LEVEL); */
  LOG_INF("tcp_client function start");

  int ret;
  int sock = 0, valread, client_fd;
  struct sockaddr_in serv_addr;
  char* hello = "Hello from esp32 client";
	char buf[RECV_BUF_SIZE];
  if ((sock = socket(AF_INET, SOCK_STREAM, 0)) < 0) {
    LOG_ERR("Socket creation error");
    return -1;
  }

  serv_addr.sin_family = AF_INET;
  serv_addr.sin_port = htons(CONFIG_PORT_SERVER);
  LOG_INF("sin_port config");

  // Convert IPv4 and IPv6 addresses from text to binary
  // form
  if (inet_pton(AF_INET, CONFIG_IP_SERVER, &serv_addr.sin_addr)
      <= 0) {
    LOG_ERR("Invalid address/ Address not supported");
    return -1;
  }

  if ((client_fd
        = connect(sock, (struct sockaddr*)&serv_addr,
          sizeof(serv_addr)))
      < 0) {
    LOG_ERR("Connection Failed %d", client_fd);
    return -1;
  }
  else
  {
    LOG_INF("Connection OK %d", client_fd);
  }

  sendall(sock, hello, strlen(hello));
  LOG_INF("Hello message sent");

  /* valread = recv(sock, buf, sizeof(buf), MSG_DONTWAIT); */
  /* LOG_INF("%s\n", buffer); */

  /* do { */
  /*   valread = recv(sock, buf, sizeof(buf), MSG_DONTWAIT); */

		/* /1* No data or error. *1/ */
		/* if (valread == 0) { */
			/* ret = -EIO; */
			/* continue; */
		/* } else if (valread < 0) { */
			/* if (errno == EAGAIN || errno == EWOULDBLOCK) { */
				/* ret = 0; */
			/* } else { */
				/* ret = -errno; */
			/* } */
			/* continue; */
		/* } */

	/* } while (valread > 0); */


  // closing the connected socket
  close(client_fd);
  return 0;
}
```

## src/wifi.c
```c
/*
 * Copyright (c) 2020 Gerson Fernando Budke <nandojve@gmail.com>
 *
 * SPDX-License-Identifier: Apache-2.0
 */

#include "wifi.h"
#include <zephyr/net/wifi_mgmt.h>

static int connected;
static struct net_mgmt_event_callback wifi_shell_mgmt_cb;

static void handle_wifi_connect_result(struct net_mgmt_event_callback *cb)
{

  LOG_MODULE_DECLARE(main, CONFIG_LOG_DEFAULT_LEVEL);
  /* LOG_MODULE_DECLARE(handle_wifi_connect_result, CONFIG_LOG_DEFAULT_LEVEL); */
	const struct wifi_status *status = (const struct wifi_status *)
					   cb->info;

	if (status->status) {
		LOG_ERR("Connection request failed (%d)", status->status);
	} else {
		LOG_INF("WIFI Connected");
		connected = 1;
	}
}

static void wifi_mgmt_event_handler(struct net_mgmt_event_callback *cb,
				    uint32_t mgmt_event, struct net_if *iface)
{
  LOG_MODULE_DECLARE(wifi_mgmt_event_handler, CONFIG_LOG_DEFAULT_LEVEL);
	switch (mgmt_event) {
	case NET_EVENT_WIFI_CONNECT_RESULT:
		handle_wifi_connect_result(cb);
		break;
	default:
		break;
	}
}

void wifi_connect(void)
{

  LOG_MODULE_DECLARE(main, CONFIG_LOG_DEFAULT_LEVEL);
  /* LOG_MODULE_DECLARE(wifi_connect, CONFIG_LOG_DEFAULT_LEVEL); */
	int nr_tries = 10;
	int ret = 0;

	net_mgmt_init_event_callback(&wifi_shell_mgmt_cb,
				     wifi_mgmt_event_handler,
				     NET_EVENT_WIFI_CONNECT_RESULT);

	net_mgmt_add_event_callback(&wifi_shell_mgmt_cb);

	struct net_if *iface = net_if_get_default();
	static struct wifi_connect_req_params cnx_params = {
		.ssid = CONFIG_WIFI_SSID,
		.ssid_length = 0,
		.psk = CONFIG_WIFI_PSK,
		.psk_length = 0,
		.channel = 0,
		.security = WIFI_SECURITY_TYPE_PSK,
	};

	cnx_params.ssid_length = strlen(CONFIG_WIFI_SSID);
	cnx_params.psk_length = strlen(CONFIG_WIFI_PSK);

	connected = 0;

	LOG_INF("WIFI try connecting to %s...", CONFIG_WIFI_SSID);

	/* Let's wait few seconds to allow wifi device be on-line */
	while (nr_tries-- > 0) {
		ret = net_mgmt(NET_REQUEST_WIFI_CONNECT, iface, &cnx_params,
			       sizeof(struct wifi_connect_req_params));
		if (ret == 0) {
			break;
		}

		LOG_INF("Connect request failed %d. Waiting iface be up...", ret);
		k_msleep(500);
	}

	while (connected == 0) {
		k_msleep(100);
	}
}
```
