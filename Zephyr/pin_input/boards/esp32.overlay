/* ~/zephyrproject/zephyr/boards/xtensa/esp32 */
/* ~/zephyrproject/zephyr/soc/xtensa/esp32/ */
/* ~/zephyrproject/zephyr/dts/xtensa/espressif/esp32.dtsi */
/* ~/zephyrproject/zephyr/include/dt-bindings/gpio/gpio.h */
/* ~/zephyrproject/zephyr/drivers/gpio/gpio_esp32.c */
/* ~/zephyrproject/zephyr/drivers/pinmux/pinmux_esp32.c */
/* ~/zephyrproject/zephyr/dts/bindings/gpio/espressif,esp32-gpio.yaml */

/* dts: https://docs.zephyrproject.org/latest/build/dts/index.html */
/* pinmux: https://docs.opentitan.org/hw/ip/pinmux/doc/ */

/ {

	aliases {
		push-button = &sensor1_label;
	};

	gpio_keys {
		compatible = "gpio-keys";
		/*Sensor 1*/
		sensor1_label: sensor_1 {
      /* Positive logic */
			gpios = <&gpio0 23 GPIO_ACTIVE_HIGH>;
      /* Negative logic */
			/* gpios = <&gpio0 23 GPIO_ACTIVE_LOW>; */
			label = "Sensor 1";
		};	
	};

};
	
	
